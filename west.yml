## west.yml
```yaml
manifest:
  group-filter: [-placeholder]
  projects:
    - name: zmk-module-placeholder
      url: git@github.com:Nick-Munnich/zmk-module-template.git
      revision: main
      groups: [placeholder]
  self:
    import:
      - behaviors
      - components
      - drivers
      - features
      - keyboards
      - vfx
```
